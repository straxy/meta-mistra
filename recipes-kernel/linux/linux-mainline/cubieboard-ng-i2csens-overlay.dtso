// SPDX-License-Identifier: GPL-2.0-or-later OR MIT
/*
 * Copyright 2025 Strahinja Jankovic <strahinja@mistrasolutions.com>
 */

// CubieboardNG Custom QEMU I2C device

/dts-v1/;
/plugin/;

/ {
	compatible = "cubietech,a10-cubieboard", "allwinner,sun4i-a10";
};

&i2c0 {
	#address-cells = <1>;
	#size-cells = <0>;
	status = "okay";

	i2csens: sens@36 {
		compatible = "mistra,i2csens";
		reg = <0x36>;
	};
};
